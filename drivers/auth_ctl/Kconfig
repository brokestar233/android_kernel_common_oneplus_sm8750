## drivers/auth_ctl/Kconfig
```kconfig
# SPDX-License-Identifier: GPL-2.0
config AUTHORITY_CTRL
	tristate "Authority Control for RTG & QOS"
	default y
	help
	  Control thread's authority for specific kenrel feature such as RTG
	  or QOS. Use uid as the authentication granularity. Status switching
	  will change uid's authority, and would trigger additional actions
	  registered by specific kernel feature.

config QOS_CTRL
	bool "Multiple Level Qos Control for thread"
	default y
	depends on AUTHORITY_CTRL
	help
	  If set, thread can apply qos for less execution latency and get more
	  cpu supply. Permission and absolute supply aggressiveness was controlled
	  by AUTHORITY_CTRL.

config RTG_AUTHORITY
	bool "Authority Control for SCHED_RTG_FRAME"
	default n
	depends on AUTHORITY_CTRL
	depends on SCHED_RTG_FRAME
	help
	  Authority control for SCHED_RTG_FRAME. If set, access to SCHED_RTG_FRAME's
	  ioctl cmd will be restricted.

config QOS_AUTHORITY
	bool "Authority Control for QOS_CTRL"
	default y
	depends on AUTHORITY_CTRL
	depends on QOS_CTRL
	help
	  Authority control for QOS_CTRL. If set, access to QOS_CTRL's ioctl cmd will
	  be restricted.

config AUTH_QOS_DEBUG
	bool "Debug fs for qos_ctrl and auth_ctrl"
	default n
	depends on AUTHORITY_CTRL
	depends on RTG_AUTHORITY
	depends on QOS_AUTHORITY
	help
	  If set, debug node will show auth and qos info

config QOS_POLICY_MAX_NR
	int "Number of supported qos policy"
	range 5 20
	default 5
	depends on QOS_CTRL
	help
	  Qos policy number limit. Truly initialized qos policy could small then
	  this value.
```

## drivers/block/zram/Kconfig
```kconfig
# SPDX-License-Identifier: GPL-2.0
config ZRAM
	tristate "Compressed RAM block device support"
	depends on BLOCK && SYSFS && MMU
	depends on CRYPTO_LZO || CRYPTO_LZ4 || CRYPTO_LZ4HC || CRYPTO_LZ4K || CRYPTO_LZ4K_OPLUS || CRYPTO_LZ4KD || CRYPTO_DEFLATE || CRYPTO_842 || CRYPTO_ZSTD
	select ZSMALLOC
	help
	  Creates virtual block devices called /dev/zramX (X = 0, 1, ...).
	  Pages written to these disks are compressed and stored in memory
	  itself. These disks allow very fast I/O and compression provides
	  good amounts of memory savings.

	  It has several use cases, for example: /tmp storage, use as swap
	  disks and maybe many more.

	  See Documentation/admin-guide/blockdev/zram.rst for more information.

choice
	prompt "Default zram compressor"
	default ZRAM_DEF_COMP_LZ4KD
	depends on ZRAM

config ZRAM_DEF_COMP_LZO
	bool "lzo"
	depends on CRYPTO_LZO

config ZRAM_DEF_COMP_LZORLE
	bool "lzo-rle"
	depends on CRYPTO_LZO

config ZRAM_DEF_COMP_LZ4
	bool "lz4"
	depends on CRYPTO_LZ4

config ZRAM_DEF_COMP_LZ4HC
	bool "lz4hc"
	depends on CRYPTO_LZ4HC

config ZRAM_DEF_COMP_LZ4K
	bool "lz4k"
	depends on CRYPTO_LZ4K
	
config ZRAM_DEF_COMP_LZ4K_OPLUS
	bool "lz4k"
	depends on CRYPTO_LZ4K_OPLUS

config ZRAM_DEF_COMP_LZ4KD
	bool "lz4kd"
	depends on CRYPTO_LZ4KD

config ZRAM_DEF_COMP_DEFLATE
	bool "deflate"
	depends on CRYPTO_DEFLATE

config ZRAM_DEF_COMP_842
	bool "842"
	depends on CRYPTO_842

config ZRAM_DEF_COMP_ZSTD
	bool "zstd"
	depends on CRYPTO_ZSTD

endchoice

config ZRAM_DEF_COMP
	string
	default "lzo" if ZRAM_DEF_COMP_LZO
	default "lzo-rle" if ZRAM_DEF_COMP_LZORLE
	default "lz4" if ZRAM_DEF_COMP_LZ4
	default "lz4hc" if ZRAM_DEF_COMP_LZ4HC
	default "lz4k" if ZRAM_DEF_COMP_LZ4K
	default "lz4k_oplus" if ZRAM_DEF_COMP_LZ4K_OPLUS
	default "lz4kd" if ZRAM_DEF_COMP_LZ4KD
    	default "deflate" if ZRAM_DEF_COMP_DEFLATE
	default "842" if ZRAM_DEF_COMP_842
	default "zstd" if ZRAM_DEF_COMP_ZSTD

config ZRAM_WRITEBACK
       bool "Write back incompressible or idle page to backing device"
       depends on ZRAM
       help
	 With incompressible page, there is no memory saving to keep it
	 in memory. Instead, write it out to backing device.
	 For this feature, admin should set up backing device via
	 /sys/block/zramX/backing_dev.

	 With /sys/block/zramX/{idle,writeback}, application could ask
	 idle page's writeback to the backing device to save in memory.

	 See Documentation/admin-guide/blockdev/zram.rst for more information.

config ZRAM_TRACK_ENTRY_ACTIME
	bool "Track access time of zram entries"
	depends on ZRAM
	help
	  With this feature zram tracks access time of every stored
	  entry (page), which can be used for a more fine grained IDLE
	  pages writeback.

config ZRAM_MEMORY_TRACKING
	bool "Track zRam block status"
	depends on ZRAM && DEBUG_FS
	select ZRAM_TRACK_ENTRY_ACTIME
	help
	  With this feature, admin can track the state of allocated blocks
	  of zRAM. Admin could see the information via
	  /sys/kernel/debug/zram/zramX/block_state.

	  See Documentation/admin-guide/blockdev/zram.rst for more information.

config ZRAM_MULTI_COMP
	bool "Enable multiple compression streams"
	depends on ZRAM
	help
	  This will enable multi-compression streams, so that ZRAM can
	  re-compress pages using a potentially slower but more effective
	  compression algorithm. Note, that IDLE page recompression
	  requires ZRAM_TRACK_ENTRY_ACTIME.

config OPLUS_FEATURE_ZRAM_OPT
	tristate "zram optimization"
	default y
	help
	  define this config to add oplus zram optimization feature
```

## drivers/cpufreq_bouncing/Kconfig
```kconfig
config OPLUS_FEATURE_GKI_CPUFREQ_BOUNCING
	tristate "cpufreq_bouncing"
	default m
	select OPLUS_FEATURE_CPU_QOS_ARBITER
	help
	  adjust cpu max frequency based on cpu busy duration

config OPLUS_FEATURE_CEILING_FREE
	tristate "ceiling free"
	default y
	help
	  set cb/omrg max frequency to default when user touch screen.
```

## drivers/freq_qos_arbiter/Kconfig
```kconfig
# SPDX-License-Identifier: GPL-2.0-only
# Copyright (C) 2025 Oplus. All rights reserved.

config OPLUS_FEATURE_CPU_QOS_ARBITER
    tristate "Integrate qos requests"
    default y
    help
        Integrate qos requests

config OPLUS_FEATURE_CPU_QOS_ARBITER_TEST
    tristate "Integrate qos requests test"
    default n
    help
        Integrate qos requests test
```

## drivers/oplus_omrg/Kconfig
```kconfig
config OPLUS_OMRG
  tristate "oplus multiple rail group"
  default m
  help
    manager frequency dependency caused by multiple rail between
    different cpufreq device and devfreq device
```

## drivers/sigkill_diagnosis/Kconfig
```kconfig
# SPDX-License-Identifier: GPL-2.0-only
# Copyright (C) 2022-2030 Oplus. All rights reserved.

config OPLUS_FEATURE_SIGKILL_DIAGNOSIS
	tristate "sigkill diagnosis driver"
	default y
	help
	  assist sigkill diagnosis. record kill reason category for athena
```

## lib/lz4k_oplus/Kconfig
```kconfig
config CRYPTO_LZ4K_OPLUS
	tristate "Lz4k_oplus compression algorithm"
	select CRYPTO_ALGAPI
	select CRYPTO_ACOMP2
	help
	  This is the lz4k_oplus algorithm.
```
